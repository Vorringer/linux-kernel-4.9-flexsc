## drivers/my_driver/Kconfig
```kconfig
config MY_DRIVER
tristate "my driver"
depends on X86
default y if X86
help
  my driver module.
```

## drivers/shmem/Kconfig
```kconfig
config SHMEM_DRIVER
tristate "shmem driver"
depends on X86
default y if X86
help
  shmem driver module.
```
